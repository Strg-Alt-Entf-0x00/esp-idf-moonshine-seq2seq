## Kconfig
```kconfig
menu "Moonshine ASR Configuration"

    config MOONSHINE_ENABLE_AUDIO_UTILS
        bool "Enable audio preprocessing utilities"
        default y
        help
            Enable built-in audio preprocessing utilities (resampling, format conversion, etc.)
            
            These utilities provide convenient functions to convert audio from various formats
            (different sample rates, bit depths, channel counts) to the 16kHz mono int16 format
            required by Moonshine.
            
            If disabled, applications must provide audio in the correct format themselves.
            This can reduce binary size if you have your own audio pipeline.

    config MOONSHINE_MAX_VOCAB_SIZE
        int "Maximum vocabulary size"
        default 32768
        range 1000 65536
        help
            Maximum vocabulary size supported by the tokenizer.
            Reduce to save memory if using smaller models.

    config MOONSHINE_MAX_HIDDEN_SIZE
        int "Maximum hidden dimension size"
        default 512
        range 128 2048
        help
            Maximum hidden dimension size for model architecture.
            Must be >= the actual model's hidden size.

    config MOONSHINE_MAX_LAYERS
        int "Maximum number of layers"
        default 12
        range 1 24
        help
            Maximum number of encoder/decoder layers.
            Must be >= the actual model's layer count.

    config MOONSHINE_ENABLE_DEBUG_LOGGING
        bool "Enable detailed debug logging"
        default n
        help
            Enable verbose logging for debugging model loading and inference.
            Warning: This can generate a lot of output and slow down performance.

endmenu
```

## examples/ws-esp32-p4-wifi6-console-asr-dev/components/board_audio/Kconfig
```kconfig
menu "ASR microphone input"

choice ASR_MIC_DEFAULT
    prompt "Default microphone input"
    default ASR_MIC_DEFAULT_ONBOARD
    help
        Select the input used after boot. The source can also be changed from
        the console while capture is stopped.

    config ASR_MIC_DEFAULT_ONBOARD
        bool "Onboard analog microphone via ES8311"

    config ASR_MIC_DEFAULT_INMP441
        bool "External 24-bit I2S microphone"
endchoice

config ASR_ES8311_MIC_GAIN_DB
    int "Onboard ES8311 microphone PGA gain (dB)"
    default 36
    range 0 42
    help
        Supported values are 0, 6, 12, 18, 24, 30, 36, and 42 dB. Start with
        a moderate value and use the mic level command to check noise and
        clipping before increasing gain.

config ASR_INMP441_BCLK_GPIO
    int "External I2S microphone BCLK GPIO"
    default 20
    range 0 54

config ASR_INMP441_WS_GPIO
    int "External I2S microphone WS GPIO"
    default 21
    range 0 54

config ASR_INMP441_DIN_GPIO
    int "External I2S microphone data-in GPIO"
    default 22
    range 0 54

choice ASR_INMP441_SLOT
    prompt "External I2S microphone slot"
    default ASR_INMP441_SLOT_LEFT
    help
        Match this setting to the microphone L/R pin wiring.

    config ASR_INMP441_SLOT_LEFT
        bool "Left slot (L/R low)"

    config ASR_INMP441_SLOT_RIGHT
        bool "Right slot (L/R high)"
endchoice

endmenu
```
